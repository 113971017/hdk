/*
 * Software Platform: ROM-functions
 *
 * Copyright (C) 2015 Melexis N.V.
 *
 * NOTE!!!	This file is auto-generated by the get-rom-functions.py script.
 *       	Please DO NOT edit.
 */

	PROVIDE(_Dcdc_Init = 0x00004398);
	PROVIDE(_Dcdc_InitAndRestart = 0x000043a6);
	PROVIDE(write_all_1 = 0x000044ae);
	PROVIDE(read_flash_sbc_ded = 0x000044d6);
	PROVIDE(fast_erase_start = 0x000044de);
	PROVIDE(test_cyc20 = 0x0000450a);
	PROVIDE(read_flash_all = 0x00004532);
	PROVIDE(test_xy = 0x0000454c);
	PROVIDE(test_erase_sps = 0x0000457c);
	PROVIDE(test_chess = 0x00004654);
	PROVIDE(test_ichess = 0x00004658);
	PROVIDE(test_cmr = 0x000046ac);
	PROVIDE(get_revision = 0x0000478e);
    PROVIDE(_rom_write_tr5 = 0x000043f0);
